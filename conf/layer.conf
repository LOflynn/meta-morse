## conf/layer.conf
```bitbake
# We have a conf and classes directory, add to BBPATH
BBPATH .= ":${LAYERDIR}"

# We have recipes-* directories, add to BBFILES
BBFILES += "${LAYERDIR}/recipes-*/*/*.bb \
            ${LAYERDIR}/recipes-*/*/*.bbappend"

BBFILE_COLLECTIONS += "meta-morse"
BBFILE_PATTERN_meta-morse = "^${LAYERDIR}/"
BBFILE_PRIORITY_meta-morse = "6"

LAYERDEPENDS_meta-morse = "core"
LAYERSERIES_COMPAT_meta-morse = "kirkstone"
```
